## bigfish/sdk/scripts/kconfig/Kconfig.advca
```kconfig
#+++++++++++++++++++++++++++++++++++++++++++++++++++
menuconfig HI_ADVCA_SUPPORT
	bool "Advance CA Support"
	default n
#--------------------------------
choice
	prompt "Advance CA Type"
	depends on HI_ADVCA_SUPPORT
	default ADVCA_OTHER
config  ADVCA_CONAX
	bool "Conax"
	depends on (!HI3798MV100 && !HI3796MV100)
config  ADVCA_NOVEL
	bool "Novel"
config  ADVCA_NAGRA
	bool "Nagra"
	depends on (!HI3798MV100 && !HI3796MV100)
config  ADVCA_SUMA
	bool "Suma"
config  ADVCA_CTI
	bool "Cti"
config  ADVCA_VERIMATRIX
	bool "Verimatrix"
	depends on (HI3798MV100 ||HI3796MV100)
config  ADVCA_IRDETO
	bool "Irdeto"
config  ADVCA_PANACCESS
	bool "Panaccess"
config  ADVCA_DCAS
	bool "Dcas"
	depends on (!HI3798MV100 && !HI3796MV100)
config  ADVCA_OTHER
	bool "Other"
endchoice

config  HI_ADVCA_TYPE
	string
	depends on HI_ADVCA_SUPPORT
	default CONAX           if ADVCA_CONAX
	default NOVEL           if ADVCA_NOVEL
	default NAGRA           if ADVCA_NAGRA
	default SUMA            if ADVCA_SUMA
	default CTI             if ADVCA_CTI
	default VERIMATRIX      if ADVCA_VERIMATRIX
	default IRDETO		if ADVCA_IRDETO
	default PANACCESS	if ADVCA_PANACCESS
	default DCAS		if ADVCA_DCAS
	default OTHER           if ADVCA_OTHER
#--------------------------------


menuconfig ADVCA_FUNCTION
	bool "Advance CA Function"
	depends on HI_ADVCA_SUPPORT
	default n

choice
	prompt "Advca Function"
	depends on ADVCA_FUNCTION

config  FUNCTION_DEBUG
	bool "DEBUG"
config  FUNCTION_RELEASE
	bool "RELEASE"
config  FUNCTION_FINAL
	bool "FINAL"

endchoice

config  HI_ADVCA_FUNCTION
	string
	depends on ADVCA_FUNCTION
	default DEBUG       if FUNCTION_DEBUG
	default RELEASE     if FUNCTION_RELEASE
	default FINAL       if FUNCTION_FINAL

config HI_STATIC_LIB_ONLY
	bool
	default y
	depends on ADVCA_FUNCTION

config HI_ADVCA_VMX_3RD_SIGN
    bool "Verimatrix Third-Party Sign Solution"
    depends on (HI_ADVCA_SUPPORT && ADVCA_VERIMATRIX)
	default n
    help
      If you want to enable verimatrix third-party signing solution, say y.
```

## bigfish/sdk/scripts/kconfig/Kconfig.apploader
```kconfig
menuconfig HI_LOADER_APPLOADER
	bool "AppLoader Config"
	depends on HI_APPLOADER_SUPPORT

#------------------------------------------------
choice
	prompt "OSD Language Type"
	default HI_APPLOADER_OSD_LANG_EN
	depends on HI_LOADER_APPLOADER

config  HI_APPLOADER_OSD_LANG_EN
	bool "English"

config  HI_APPLOADER_OSD_LANG_CN
	bool "Chinese"
endchoice

#------------------------------------------------
config  HI_APPLOADER_MODE_USB
	bool "USB Upgrade Support"
	default y
	depends on HI_LOADER_APPLOADER
	select HI_NTFS_SUPPORT

#------------------------------------------------
choice
        prompt "Protocol Type"
        default HI_APPLOADER_USB_PROTOCOL_HISI_FILE
        depends on HI_APPLOADER_MODE_USB

config  HI_APPLOADER_USB_PROTOCOL_HISI_FILE
        bool "Hisi File Protocol"
endchoice

#------------------------------------------------
config  HI_APPLOADER_MODE_IP
	bool "IP Upgrade Support"
	depends on HI_LOADER_APPLOADER && !ADVCA_VERIMATRIX
	default y
	select HI_CURL_SUPPORT

#------------------------------------------------
choice
        prompt "Protocol Type"
        default HI_APPLOADER_IP_PROTOCOL_HISI_FILE
        depends on HI_APPLOADER_MODE_IP

config  HI_APPLOADER_IP_PROTOCOL_HISI_FILE
        bool "Hisi File Protocol"
endchoice

#------------------------------------------------
config  HI_APPLOADER_MODE_OTA
	bool "OTA Upgrade Support"
	default y
	depends on HI_LOADER_APPLOADER && HI_FRONTEND_SUPPORT

#------------------------------------------------
choice
	prompt "Tuner Type"
	default HI_APPLOADER_TUNER_CAB
	depends on HI_APPLOADER_MODE_OTA

config  HI_APPLOADER_TUNER_CAB
	bool "Cable"

config  HI_APPLOADER_TUNER_TER
	bool "Terrestrial"

config  HI_APPLOADER_TUNER_SAT
	bool "Satellite"
endchoice

#------------------------------------------------
choice
	prompt "Protocol Type"
	default HI_APPLOADER_PROTOCOL_HISI_OTA
	depends on HI_APPLOADER_MODE_OTA

config  HI_APPLOADER_PROTOCOL_SSU_OTA
	bool "SSU Protocol"

config  HI_APPLOADER_PROTOCOL_HISI_OTA
	bool "Hisi OTA Protocol"
endchoice

#+++++++++++++++++++++++++++++++++++++++++++++++++++
```

## bigfish/sdk/scripts/kconfig/Kconfig.audio
```kconfig
#++++++++++++++++++++++++++++++++++++++++++++++++++++
menu "Audio Config"
#--------------------------------
config	HI_SND_ALSA_AO_SUPPORT
	bool "AO ALSA Support"
	default n

config HI_AI_SUPPORT
	bool "AI Support"
	default n

config	HI_SND_ALSA_AI_SUPPORT
	depends on HI_AI_SUPPORT
	bool "AI ALSA Support"
	default n

config	HI_SND_ALSA_I2S_ONLY_SUPPORT
	depends on HI_SND_ALSA_AI_SUPPORT
	bool "ALSA I2S only Card Support"
	default n

config	HI_SND_ALSA_HDMI_ONLY_SUPPORT
	depends on HI_SND_ALSA_AI_SUPPORT
	bool "ALSA HDMI only Card Support"
	default n

config HI_ADEC_MAX_INSTANCE
	int "ADEC Max Instance Number(1~8)"
	range 1 8
	default 8

config HI_ADEC_AUDSPECTRUM_SUPPORT
	bool "ADEC Audio Spectrum Support"
	default n

config HI_SND_SMARTVOLUME_SUPPORT
	bool "SND Smart Volume Support"
	default n

config HI_SND_VIRTUALCHN_SUPPORT
	bool "SND Virtual Channel Support"
	default n

config HI_SND_AOE_HW_SUPPORT
	bool "SND Hardware Aoe Support"
	depends on HI3716CV200 || HI3716MV400 || HI3718CV100 || HI3719CV100 || HI3718MV100 || HI3719MV100
	default n

config HI_RESAMPLER_QUALITY_LINEAR
	bool "Linear Resampler"
	default n

config HI_AENC_SUPPORT
	bool "AENC Support"
	default y

config HI_SND_SIF_SUPPORT
	bool "SIF Support"
	default n

menuconfig  HI_ADAC_SUPPORT
	bool "ADAC Support"
	default n

choice
	prompt "Codec Support"
	depends on HI_ADAC_SUPPORT

config  HI_ADAC_SLIC_SUPPORT
	bool "slic"

config  HI_ADAC_TVL320AIC31_SUPPORT
	bool "tlv320"

endchoice

config HI_ALSA_TVL320_KERNEL_SUPPORT
	bool "KERNEL Tlv320 Support"
	default n

#--------------------------------
endmenu
#++++++++++++++++++++++++++++++++++++++++++++++++++++
```

## bigfish/sdk/scripts/kconfig/Kconfig.base
```kconfig
###########################################################
choice
    prompt "Product Type"
    default LINUX_PRODUCT

config  LINUX_PRODUCT
    bool "linux"
config  ANDROID_PRODUCT
    bool "android"
endchoice

config  PRODUCT_TYPE
    string
    default linux            if LINUX_PRODUCT
    default android          if ANDROID_PRODUCT

###########################################################
choice
    prompt "Chip Type"
    default hi3716cv200

config  HI3716CV200
    bool "hi3716cv200"
config  HI3716MV400
    bool "hi3716mv400"
config  HI3716MV410
    bool "hi3716mv410"
config  HI3716MV420
    bool "hi3716mv420"
config  HI3718CV100
    bool "hi3718cv100"
config  HI3718MV100
    bool "hi3718mv100"
config  HI3719CV100
    bool "hi3719cv100"
config  HI3719MV100
    bool "hi3719mv100"
config  HI3796CV100
    bool "hi3796cv100"
config  HI3798CV100
    bool "hi3798cv100"
config  HI3798MV100
    bool "hi3798mv100"
config  HI3796MV100
    bool "hi3796mv100"
config  HI3798CV200_A
    bool "hi3798cv200_a"
endchoice

config  HI_CHIP_TYPE
    string
    default hi3716cv200     if HI3716CV200
    default hi3716mv400     if HI3716MV400
    default hi3716mv410     if HI3716MV410
    default hi3716mv420     if HI3716MV420
    default hi3718cv100     if HI3718CV100
    default hi3718mv100     if HI3718MV100
    default hi3719cv100     if HI3719CV100
    default hi3719mv100     if HI3719MV100
    default hi3796cv100     if HI3796CV100
    default hi3798cv100     if HI3798CV100
    default hi3798mv100     if HI3798MV100
    default hi3796mv100     if HI3796MV100
    default hi3798cv200_a   if HI3798CV200_A

###########################################################
choice
    prompt "Toolchains Type"
    default ARM_HISIV200_LINUX

config  ARM_HISIV200_LINUX
    bool "arm-hisiv200-linux"

config  ARM_HISTBV300_LINUX
    bool "arm-histbv300-linux"
endchoice

config  HI_TOOLCHAINS_NAME
    string
    default arm-hisiv200-linux  if ARM_HISIV200_LINUX
    default arm-histbv300-linux if ARM_HISTBV300_LINUX

###########################################################
menuconfig  HI_LOADER_SUPPORT
    bool "HiLoader Support"
    default n

choice
    prompt "Support Loader Type"
    default HI_APPLOADER_SUPPORT    if LINUX_PRODUCT
    default HI_LOADER_RECOVERY      if ANDROID_PRODUCT
    depends on HI_LOADER_SUPPORT

config  HI_BOOTLOADER_SUPPORT
    bool "BootLoader"
    select HI_BUILD_WITH_PRODUCT

config  HI_APPLOADER_SUPPORT
    bool "AppLoader"

config  HI_LOADER_RECOVERY
    bool "Recovery"
    depends on ANDROID_PRODUCT

endchoice

###########################################################
config HI_OPTM_SIZE_SUPPORT
    bool "Optimize For Size"
    default n
```

## bigfish/sdk/scripts/kconfig/Kconfig.bluetooth
```kconfig
config HI_BLUETOOTH_SUPPORT
	bool "Bluetooth Support"
	default n
	help
	  ALSA will support too when support Bluetooth
```

## bigfish/sdk/scripts/kconfig/Kconfig.board.amp
```kconfig
#+++++++++++++++++++++++++++++++++++++++++++++++++++
menuconfig HI_SND_AMP_SUPPORT
	bool "Snd Amp Support"
	default n

choice
        prompt "Snd Amp Type"
        depends on HI_SND_AMP_SUPPORT
        help
            The amp type on your board.
        default HI_AMP_TYPE_TDA18250

config  HI_SND_AMP_TYPE_TAS5707
        bool "HI_SND_AMP_TYPE_TAS5707"
	
config  HI_SND_AMP_TYPE_TAS5711
        bool "HI_SND_AMP_TYPE_TAS5711"
endchoice

config 	HI_SND_AMP_I2C
	hex  "Snd Amp I2c"
	depends on HI_SND_AMP_SUPPORT
	default 0x44
	help
	  amp i2c
		        board_type            level	i2c_pin (i2c_pin = i2c_group * 8 + i2c_num)
		 BOARD_TYPE_hi3751		0	0x44(I2C8_4)

#+++++++++++++++++++++++++++++++++++++++++++++++++++	
```

## bigfish/sdk/scripts/kconfig/Kconfig.board.bootreg
```kconfig
#+++++++++++++++++++++++++++++++++++++++++++++++++++
menu "Boot Regfile Config"
config  HI_BOOT_REG_NAME
	prompt "Fastboot Reg File"
	string
	default hi3716mdmo3avera_hi3716mv300_ddr3_256mbyte_16bit_2layers.reg
endmenu
#+++++++++++++++++++++++++++++++++++++++++++++++++++
```

## bigfish/sdk/scripts/kconfig/Kconfig.board.eth
```kconfig
#+++++++++++++++++++++++++++++++++++++++++++++++++++
menu "Ethernet Config"
config  HI_ETH_SUPPORT
        bool "Ethernet Support"
        default y
        depends on HI_UBOOT_SUPPORT #TODO: XXX
        help
          Support ethernet function enables you to use ethernet.
          You should say y here, unless you really know what are
          you doing. Say no here can get a smaller fastboot.

endmenu
#+++++++++++++++++++++++++++++++++++++++++++++++++++
```

## bigfish/sdk/scripts/kconfig/Kconfig.board.videodac
```kconfig
#+++++++++++++++++++++++++++++++++++++++++++++++++++
menu "Video DAC Config"

config HI_DAC_CVBS
	int "CVBS"
	range 0 5
	help 
	    DAC number used as CVBS.
	default 3
	
config HI_DAC_YPBPR_Y
	depends on !HI3718CV100 && !HI3718MV100
	int "YPBPR_Y"
	range 0 5
	help 
	    DAC number used as YPBPR_Y.
	default 1
	
config HI_DAC_YPBPR_PB
	depends on !HI3718CV100 && !HI3718MV100
	int "YPBPR_PB"
	range 0 5
	help 
	    DAC number used as YPBPR_PB.
	default 2
	
config HI_DAC_YPBPR_PR
	depends on !HI3718CV100 && !HI3718MV100
	int "YPBPR_PR"
	range 0 5
	help 
	    DAC number used as YPBPR_PR.
	default 0

endmenu	
#+++++++++++++++++++++++++++++++++++++++++++++++++++
```

## bigfish/sdk/scripts/kconfig/Kconfig.bootloader
```kconfig
menuconfig HI_LOADER_BOOTLOADER
	bool "BootLoader Config"
	depends on HI_BOOTLOADER_SUPPORT
	default y

#------------------------------------------------
config  HI_BOOTLOADER_MODE_USB
	bool "USB Upgrade Support"
	depends on HI_LOADER_BOOTLOADER
	default y
	select HI_BOOT_USB_SUPPORT

#------------------------------------------------
choice
        prompt "Protocol Type"
        default HI_BOOTLOADER_USB_PROTOCOL_HISI_FILE
        depends on HI_BOOTLOADER_MODE_USB

config  HI_BOOTLOADER_USB_PROTOCOL_HISI_FILE
        bool "Hisi File Protocol"
endchoice

#------------------------------------------------
config  HI_BOOTLOADER_MODE_OTA
	bool "OTA Upgrade Support"
	depends on HI_LOADER_BOOTLOADER
	default n
	select HI_BUILD_WITH_FRONTEND
	select HI_BUILD_WITH_DEMUX

#------------------------------------------------
choice
	prompt "Tuner Type"
	default HI_BOOTLOADER_TUNER_CAB
	depends on HI_BOOTLOADER_MODE_OTA

config  HI_BOOTLOADER_TUNER_CAB
	bool "Cable"

config  HI_BOOTLOADER_TUNER_SAT
	bool "Satellite"

config  HI_BOOTLOADER_TUNER_DVB_T
    bool "Terrestrial DVB_T"

config  HI_BOOTLOADER_TUNER_DVB_T2
    bool "Terrestrial DVB_T2"
endchoice

#------------------------------------------------
choice
	prompt "Protocol Type"
	default HI_BOOTLOADER_PROTOCOL_HISI_OTA
	depends on HI_BOOTLOADER_MODE_OTA

config  HI_BOOTLOADER_PROTOCOL_SSU_OTA
	bool "SSU Protocol"

config  HI_BOOTLOADER_PROTOCOL_HISI_OTA
	bool "Hisi OTA Protocol"
endchoice
```

## bigfish/sdk/scripts/kconfig/Kconfig.ci
```kconfig
#+++++++++++++++++++++++++++++++++++++++++++++++++++
menu "CI/CI+ Config"
#--------------------------------
menuconfig HI_CIPLUS_SUPPORT
	bool "CI/CI+ Support"
	default n
	
choice
prompt "Device type"
	depends on HI_CIPLUS_SUPPORT
	default HI_CI_DEV_HICI
config HI_CI_DEV_CIMAX
	bool "CIMAX"
config HI_CI_DEV_CIMAXPLUS
	bool "CIMAXPLUS"
config HI_CI_DEV_HICI
	bool "HICI"
endchoice

menuconfig HI_CIMAXPLUS_MODE_CONFIG
	bool "CIMAXPLUS mode config"
	depends on HI_CIPLUS_SUPPORT && HI_CI_DEV_CIMAXPLUS
	default y

config HI_CIMAXPLUS_MODE_USB
	bool "USB"
	depends on HI_CIPLUS_SUPPORT && HI_CI_DEV_CIMAXPLUS && HI_CIMAXPLUS_MODE_CONFIG
	default y
	
config HI_CIMAXPLUS_MODE_SPI
	bool "SPI"
	depends on HI_CIPLUS_SUPPORT && HI_CI_DEV_CIMAXPLUS && HI_CIMAXPLUS_MODE_CONFIG
	default n

#--------------------------------
endmenu
#+++++++++++++++++++++++++++++++++++++++++++++++++++
```

## bigfish/sdk/scripts/kconfig/Kconfig.curl
```kconfig
config HI_CURL_SUPPORT
	bool "Curl Support"
	default n
	help
	  If you wan't to support curl, say y here.
```

## bigfish/sdk/scripts/kconfig/Kconfig.frontend.dvb_t
```kconfig
menu "DVB-T/T2 Demod Config"
    depends on HI_DVBT_SUPPORT

config  HI_DEMOD_TYPE_HI3137
    bool "HI3137 Support"
    default y
    select HI_GPIOI2C_SUPPORT

config  HI_DEMOD_TYPE_CXD2837
    bool "CXD2837 Support"
    default y
    select HI_GPIOI2C_SUPPORT

config  HI_DEMOD_TYPE_MXL101
    bool "MXL101 Support"
    default y
    select HI_GPIOI2C_SUPPORT

config  HI_DEMOD_TYPE_MN88472
    bool "MN88472 Support"
    default y
    select HI_GPIOI2C_SUPPORT

config  HI_DEMOD_TYPE_IT9170
    bool "IT9170 Support"
    default y
    select HI_GPIOI2C_SUPPORT
endmenu

menu "DVB-T/T2 Tuner Config"
    depends on HI_DVBT_SUPPORT

config  HI_TUNER_TYPE_CXD2861
    bool "CXD2861 Support"
    default y

config  HI_TUNER_TYPE_RAFAEL836
    bool "Rafael836 Support"
    default y

config  HI_TUNER_TYPE_MXL603
    bool "MXL603 Support"
    default y

config  HI_TUNER_TYPE_MXL608
    bool "MXL608 Support"
    default y
    
config  HI_TUNER_TYPE_SI2147
        bool "Si2147 Support"
        default y
config  HI_TUNER_TYPE_TDA182I5A
        bool "TDA182I5A Support"
        default y
config  HI_TUNER_TYPE_SI2144
        bool "SI2144 Support"
        default y
endmenu
```
