## bigfish/sdk/scripts/kconfig/Kconfig.gpu
```kconfig
#+++++++++++++++++++++++++++++++++++++++++++++++++++
menu "GPU Config"

config HI_GPU
	tristate "Mali-300/400/450 support"
	---help---
	  This enables support for the ARM Mali-300, Mali-400, and Mali-450
	  GPUs.

	  To compile this driver as a module, choose M here: the module will be
	  called mali.

config HI_GPU_MALI400_SUPPORT
	bool
	depends on HI_GPU && (HI3716CV200 || HI3716MV400 || HI3718CV100 || HI3718MV100 || HI3719CV100 || HI3719MV100)
	default y

config HI_GPU_MALI450_SUPPORT
	bool
	depends on HI_GPU && (HI3796CV100 || HI3798CV100 || HI3751V100 || HI3798MV100 || HI3796MV100)
	default y

config HI_GPU_MALI700_SUPPORT
	bool
	depends on HI_GPU && (HI3798CV200 || HI3798CV200_A)
	default y

config HI_GPU_DEBUG
	bool "Enable debug in Mali driver"
	depends on HI_GPU
	---help---
	  This enabled extra debug checks and messages in the Mali driver.

config HI_GPU_PROFILING
	bool "Enable Mali profiling"
	depends on HI_GPU
	default y
	---help---
	  This enables gator profiling of Mali GPU events.

config HI_GPU_INTERNAL_PROFILING
	bool "Enable internal Mali profiling API"
	depends on HI_GPU_PROFILING
	default n
	---help---
	  This enables the internal legacy Mali profiling API.


config HI_GPU_MAX_SHARE_MEM_SIZE
	hex "Mali400 and OS maximal shared memory size"
	depends on HI_GPU
	default "0x10000000"
	---help---
	  This constricts the maximal memory GPU could get from os memory.

choice
	prompt "EGL Native Window System Config"
	depends on HI_GPU
	default EGL_FB
config  EGL_HIGO
	bool "Higo"
config  EGL_FB
	bool "FB"
config  EGL_DFB
	bool "DirectFB"
endchoice

config  HI_EGL_TYPE
	depends on HI_GPU
	string
	default higo 	 if EGL_HIGO
	default fb	 if EGL_FB
	default directfb if EGL_DFB

endmenu
#+++++++++++++++++++++++++++++++++++++++++++++++++++
```

## bigfish/sdk/scripts/kconfig/Kconfig.graph
```kconfig
#+++++++++++++++++++++++++++++++++++++++++++++++++++
menu "Graphic Config"

choice
        prompt "jpeg version"
        default LIB_JPEG_VERSION_6B

config  LIB_JPEG_VERSION_6B
        bool "libjpeg-6b"
config  LIB_JPEG_VERSION_9A
        bool "libjpeg-9a"
endchoice

choice
        prompt "png version"
        default LIB_PNG_VERSION_1_4_0

config  LIB_PNG_VERSION_1_4_0
        bool "libpng-1.4.0"
config  LIB_PNG_VERSION_1_6_16
        bool "libpng-1.6.16"
endchoice

config  HIFB_STEREO3D_SUPPORT
        bool "Hardware Stereo3d Support"
        default y

config  HIFB_COMPRESSION_SUPPORT
        bool "Compression in FB Support"
        default n

config	HIFB_SCROLLTEXT_SUPPORT
	bool "Scrolltext in FB Support"
	default n

config  HIFB_CURSOR_SUPPORT
	bool "Cursor in FB Support"
	default n

config	HI_PNG_DECODER_SUPPORT
	bool "Png Decoder Support"
	default y

config	HI_FREETYPE_FONT_SUPPORT
	bool "Freetype Font Support"
	default y

config 	HI_TDE_CSCTMPBUFFER_SIZE
	hex "TDE Temporary Buffer Size for YUV Semi-planar to YUV Package 422 or ARGB Conversion"
        default 0x0
	help
	  Regard to low quality, the size is 0.
	  Regard to middle quality, the size is (input width * input height * 2).
	  Regard to high quality, the size is(output width * output height * 3).

config 	HI_JPEG6B_STREAMBUFFER_SIZE
	hex "JPEG Stream Buffer Size"
        default 0x100000

config 	HI_HD0_FB_VRAM_SIZE
	int "KB, HD0 FrameBuffer Size"
	default 7200
        help
          For 1280*720, triple buffer, ARGB8888 format, the size is calculated as below:
          (1280*720*4*2/1024)KB

config  HI_HD1_FB_VRAM_SIZE
        int "KB, HD1 FrameBuffer Size"
        default 0
        help
          For 1280*720, triple buffer, ARGB8888 format, the size is calculated as below:
          (1280*720*4*2/1024)KB

config  HI_HD2_FB_VRAM_SIZE
        int "KB, HD2 FrameBuffer Size"
        default 0
        help
          For 1280*720, triple buffer, ARGB8888 format, the size is calculated as below:
          (1280*720*4*2/1024)KB

config 	HI_SD0_FB_VRAM_SIZE
	int "KB, SD0 FrameBuffer Size "
	default 0
        help
          For 720*576, triple buffer, ARGB8888 format, the size is calculated as below:
          (720*576*4*2/1024)KB

endmenu
#+++++++++++++++++++++++++++++++++++++++++++++++++++
```

## bigfish/sdk/scripts/kconfig/Kconfig.hacodec
```kconfig
#++++++++++++++++++++++++++++++++++++++++++++++++++++
menu "HACODEC Config"
#--------------------------------
config HI_HACODEC_MP3DECODE_SUPPORT
	bool "HACODEC MP3 Decode Support"
	default n

config HI_HACODEC_AACDECODE_SUPPORT
	bool "HACODEC AAC Decode Support"
	default n

config HI_HACODEC_AACENCODE_SUPPORT
	bool "HACODEC AAC Encode Support"
	default n

config HI_HACODEC_AC3PASSTHROUGH_SUPPORT
	bool "HACODEC AC3 Passthrough Support"
	default n

config HI_HACODEC_AMRNBCODEC_SUPPORT
	bool "HACODEC AMRNB Codec Support"
	default n

config HI_HACODEC_AMRWBCODEC_SUPPORT
	bool "HACODEC AMRWB Codec Support"
	default n

config HI_HACODEC_BLURAYLPCMDECODE_SUPPORT
	bool "HACODEC BLURAYLPCM Decode Support"
	default n

config HI_HACODEC_COOKDECODE_SUPPORT
	bool "HACODEC COOK Decode Support"
	default n

config HI_HACODEC_DRADECODE_SUPPORT
	bool "HACODEC DRA Decode Support"
	default n

config HI_HACODEC_DTSPASSTHROUGH_SUPPORT
	bool "HACODEC DTS Passthrough Support"
	default n

config HI_HACODEC_G711CODEC_SUPPORT
	bool "HACODEC G711 Codec Support"
	default n

config HI_HACODEC_G722CODEC_SUPPORT
	bool "HACODEC G722 Codec Support"
	default n

config HI_HACODEC_MP2DECODE_SUPPORT
	bool "HACODEC MP2 Decode Support"
	default n

config HI_HACODEC_PCMDECODE_SUPPORT
	bool "HACODEC PCM Decode Support"
	default n

config HI_HACODEC_TRUEHDPASSTHROUGH_SUPPORT
	bool "HACODEC TRUEHD Passthrough Support"
	default n

config HI_HACODEC_WMADECODE_SUPPORT
	bool "HACODEC WMA Decode Support"
	default n

config HI_HACODEC_PCMDECODE_HW_SUPPORT
	bool "HACODEC PCM Hardware Decode Support"
	default n

config HI_HACODEC_MP3DECODE_HW_SUPPORT
	depends on !HI_SND_AOE_HW_SUPPORT
	bool "HACODEC MP3 Hardware Decode Support"
	default n

config HI_HACODEC_DTSHDDECODE_XA_HW_SUPPORT
	depends on HI_SND_AOE_HW_SUPPORT
	bool "HACODEC DTSHDXA Hardware Decode Support"
	default n

config HI_HACODEC_DTSM6DECODE_SUPPORT
	bool "HACODEC DTSM6 Decode Support"
	default n
	depends on ANDROID_PRODUCT
#--------------------------------
endmenu
#++++++++++++++++++++++++++++++++++++++++++++++++++++
```

## bigfish/sdk/scripts/kconfig/Kconfig.haeffect
```kconfig
#++++++++++++++++++++++++++++++++++++++++++++++++++++
menu "HAEFFECT Config"
#--------------------------------
config HI_HAEFFECT_SRS_SUPPORT
	depends on HI_SND_AOE_HW_SUPPORT
	bool "HAEFFECT SRS Support"
	default n
	
config HI_HAEFFECT_BASE_SUPPORT
	bool "HAEFFECT BASE Support"
	default n
#--------------------------------
endmenu
#++++++++++++++++++++++++++++++++++++++++++++++++++++
```

## bigfish/sdk/scripts/kconfig/Kconfig.hdmi
```kconfig
#+++++++++++++++++++++++++++++++++++++++++++++++++++
menu "HDMI Config"

config  HI_HDMI_SUPPORT_1_4
    bool
    depends on HI3716CV200 || HI3716MV400 || HI3718CV100 || HI3719CV100 || HI3718MV100 || HI3719MV100 || HI3796CV100 || HI3798CV100 || HI3798MV100 || HI3796MV100
    default y

config  HI_HDMI_SUPPORT_2_0
    bool
    depends on HI3798CV200 || HI3798CV200_A
    default y

config  HI_HDMI_SUPPORT_HDCP
    bool "HDCP Support"
    help
      If you want to enable HDCP, say y.
    default n

config  HI_HDMI_SUPPORT_CEC
    bool "CEC Support"
    help
      If you want to enable CEC, say y.
    default n

config  HI_HDMI_SUPPORT_DEBUG
    bool "DEBUG Support"
    help
        If you want to enable debug, say y.
    default n

config  HI_HDMI_DEBUG_MEM_SIZE
    hex "DEBUG Memory Size (BYTE)"
    help
      If you want to enable debug, say y.
    default 0x80000


endmenu
#+++++++++++++++++++++++++++++++++++++++++++++++++++
```

## bigfish/sdk/scripts/kconfig/Kconfig.hidlna
```kconfig
config HI_DLNA_SUPPORT
	bool "HiDLNA Support"
	default n
	depends on LINUX_PRODUCT
```

## bigfish/sdk/scripts/kconfig/Kconfig.hiplayer
```kconfig
#+++++++++++++++++++++++++++++++++++++++++++++++++++
menuconfig HI_PLAYER_SUPPORT
	depends on HI_CAPTION_SO_SUPPORT && LINUX_PRODUCT
	bool "HiPlayer Support"
	default y

#------------------------------------------------
choice
	prompt "HiPlayer Version"
	depends on HI_PLAYER_SUPPORT
	default HI_PLAYER_FULL_SUPPORT

config  HI_PLAYER_FULL_SUPPORT
	bool "HiPlayer Full Support"

config  HI_PLAYER_HBBTV_SUPPORT
	bool "HiPlayer HBBTV Support"

endchoice
```

## bigfish/sdk/scripts/kconfig/Kconfig.hiplayready
```kconfig
config HI_PLAYREADY_SUPPORT
	bool "PlayReady Support"
	depends on LINUX_PRODUCT
	default n
```

## bigfish/sdk/scripts/kconfig/Kconfig.hitranscoder
```kconfig
config HI_TRANSCODER_SUPPORT
	bool "HiTranscoder Support"
	default n
	depends on LINUX_PRODUCT
```

## bigfish/sdk/scripts/kconfig/Kconfig.karaoke
```kconfig
#+++++++++++++++++++++++++++++++++++++++++++++++++++

config HI_KARAOKE_SUPPORT
	bool "KARAOKE Support"
	depends on ANDROID_PRODUCT && (HI3798MV100 || HI3796MV100 || HI3798CV200_A)
	default y

#+++++++++++++++++++++++++++++++++++++++++++++++++++
```

## bigfish/sdk/scripts/kconfig/Kconfig.kernel
```kconfig
#+++++++++++++++++++++++++++++++++++++++++++++++++++
choice
	prompt "Kernel Version"
	default LINUX-3.10.y

config  LINUX-3.10.y
	bool "linux-3.10.y"
endchoice

config  HI_KERNEL_VERSION
	string
	default linux-3.10.y if LINUX-3.10.y

config  HI_KERNEL_CFG
	prompt "Kernel Config File"
	string
	default hi3716cv200_defconfig if HI3716CV200
	help
	  Input config file for kernel. Such as xxxxx_defconfig.
	  Config files are located in kernel source: arch/arm/configs.

#---------------------------------------------
config  HI_FS_BUILDIN
	bool "Build Rootbox in Kernel"
	default n
	help
	  Say y to build rootbox in kernel.
#---------------------------------------------
config  HI_MSP_BUILDIN
	bool "Build MSP in Kernel"
	default n
	help
	  Say y to build MSP modules in kernel.	

#+++++++++++++++++++++++++++++++++++++++++++++++++++
```

## bigfish/sdk/scripts/kconfig/Kconfig.pvr
```kconfig
#++++++++++++++++++++++++++++++++++++++++++++++++++++
menu "Pvr Config"
#--------------------------------
config HI_PVR_SUPPORT
	bool "PVR Support"
	default y

config HI_PVR_L2_CACHE_SUPPORT
	depends on HI_PVR_SUPPORT
	bool "L2 Cache Support"
	default n

#--------------------------------
endmenu
#++++++++++++++++++++++++++++++++++++++++++++++++++++
```
