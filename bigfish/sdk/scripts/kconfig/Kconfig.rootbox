## bigfish/sdk/source/kernel/linux-3.10.y/drivers/ata/Kconfig.hiahci
```kconfig
#
# hisata sata ahci device configuration
#

menuconfig HI_SATA
	bool "Hisilicon Sata Device Support"
	depends on (ARCH_GODBOX || ARCH_S40 || ARCH_HI3798MX || ARCH_HIFONE)
	default n if (ARCH_GODBOX  || ARCH_S40 || ARCH_HI3798MX || ARCH_HIFONE)
	select ATA
	select ATA_VERBOSE_ERROR
	select SATA_PMP
	help
	  This selects the hisilicon sata device.

if HI_SATA

config HI_SATA_IOBASE
	hex "Hisilicon Sata IO Address"
	default "0x60040000" if ARCH_GODBOX
	default "0xF9900000" if (ARCH_S40 || ARCH_HI3798MX || ARCH_HIFONE)

config HI_SATA_IOSIZE
	hex "hi sata IO Size"
	default "0x00010000"
	help
	  default is 0x10000.

config HI_SATA_IRQNUM
	int "Hisilicon Sata IRQ Number"
	default "92" if ARCH_GODBOX
	default "102" if (ARCH_S40 || ARCH_HI3798MX || ARCH_HIFONE)

config HI_SATA_PHY_CONFIG
	hex "Hisilicon Sata PHY Config for 1.5G"
	default "0x0e03615f" if ARCH_GODBOX
	depends on ARCH_GODBOX
	help
	   SATA Phy config for 1.5G mode.

config HI_SATA_3G_PHY_CONFIG
	hex "Hisilicon Sata PHY for 3G"
	default "0x0e662753" if ARCH_GODBOX
	depends on ARCH_GODBOX
	help
	   SATA Phy config for 3G mode.

config HI_SATA_MODE
	int "Hisilicon Sata Interworking Speed Mode(1.5G:0/3G:1)"
	range 0 1
	default "0" if ARCH_GODBOX
	depends on ARCH_GODBOX

config HI_SATA_PORTS
	int "Hisilicon Sata Port Number"
	default "1" if ARCH_GODBOX
	default "2" if ARCH_HIFONE
	depends on ARCH_GODBOX || ARCH_HIFONE

config HI_SATA_PORT1
	bool "Hisilicon SATA Port1"
	default y if ARCH_HIFONE
	depends on ARCH_HIFONE

endif # HI_SATA
```

## bigfish/sdk/source/kernel/linux-3.10.y/drivers/hisilicon/Kconfig
```kconfig
menu "Hisilicon driver support"

config APP_CAPABLE
	tristate "Application Capable"
	default n
	help
	  Support application have root authority.

config APP_SEMAPHORE_API
	tristate "Semaphore API"
	default y
	help
	  Export semaphore API for SDK driver.

config  TEE_DRIVER
	tristate "Secure TEE driver"
	default n
	default y if SECURE_EXTENSION
	depends on SECURE_EXTENSION
	help
	 Provides a communication interface between userspace and
	 TrustZone Operating Environment.
endmenu
```

## bigfish/sdk/source/kernel/linux-3.10.y/drivers/hisilicon/tee/tee_hisi/tzdriver/ca_antiroot/Kconfig
```kconfig
#
# tee root scan client configuration
#

config TEE_ANTIROOT_CLIENT
        bool "A client to scan root status"
#       depends on HUAWEI_ROOT_SCAN
        default n
        help
           this is a TEE root scan client that use huawei root scan engine

config HUAWEI_ROOT_SCAN_DUMMY_API
		bool "dummy api for test of TEE_ANTIROOT_CLIENT"
		depends on TEE_ANTIROOT_CLIENT
		default n
		help
		   this is dummy api for test of TEE_ANTIROOT_CLIENT
```

## bigfish/sdk/source/kernel/linux-3.10.y/drivers/mmc/host/himciv200/Kconfig
```kconfig
#
# himci v200 device configuration
#

menuconfig HIMCIV200_SDIO_SYNOPSYS 
	tristate "Himciv200 SDIO/MMC device support"
	depends on (ARCH_GODBOX || ARCH_S40 || ARCH_HI3798MX || ARCH_HIFONE)
	default n if (ARCH_GODBOX || ARCH_S40 || ARCH_HI3798MX || ARCH_HIFONE)
	select MMC_UNSAFE_RESUME
	select MMC_EMBEDDED_SDIO
	select MMC_BLOCK
	select MMC_BLOCK_BOUNCE
	help
	  This selects the mmc family device.

if HIMCIV200_SDIO_SYNOPSYS 

menuconfig HIMCIV200_SDIO0
	bool "Himciv200 SDIO0 config"
	default y

config HIMCIV200_SDIO0_IOBASE
	hex "Himciv200 SDIO0 controller base address"
	depends on HIMCIV200_SDIO0
	default "0x601C0000" if ARCH_GODBOX
	default "0xF9820000" if (ARCH_S40 || ARCH_HI3798MX || ARCH_HIFONE)

config HIMCIV200_SDIO0_INTR
	int "Himciv200 SDIO0 irq number"
	depends on HIMCIV200_SDIO0
	default "98" if ARCH_GODBOX
	default "66" if (ARCH_S40 || ARCH_HI3798MX || ARCH_HIFONE)

config HIMCIV200_SDIO0_BUS_WIDTH_8
	bool "Himciv200 SDIO0 8bits bus support"
	depends on HIMCIV200_SDIO0
	depends on ARCH_GODBOX
	default n if ARCH_GODBOX

menuconfig HIMCIV200_SDIO1
	bool "Himciv200 SDIO1 config"
	default y

config HIMCIV200_SDIO1_IOBASE
	hex "Himciv200 SDIO1 controller base address"
	depends on HIMCIV200_SDIO1
	default "0xF9830000" if (ARCH_S40 || ARCH_HI3798MX || ARCH_HIFONE)

config HIMCIV200_SDIO1_INTR
	int "Himciv200 SDIO1 irq number"
	depends on HIMCIV200_SDIO1
	default "67" if (ARCH_S40 || ARCH_HI3798MX || ARCH_HIFONE)

menuconfig HIMCIV200_SDIO2
	bool "Himciv200 SDIO2 config"
	default n

config HIMCIV200_SDIO2_IOBASE
	hex "Himciv200 SDIO2 controller base address"
	depends on HIMCIV200_SDIO2
	default "0xF9C40000" if (ARCH_HIFONE)

config HIMCIV200_SDIO2_INTR
	int "Himciv200 SDIO2 controller irq number"
	depends on HIMCIV200_SDIO2
	default "118" if (ARCH_HIFONE)

config VOLTAGE_SWITCH
	bool "Himciv200 SDIO 1.8V voltage switch support"
	default n

endif
```

## bigfish/sdk/source/kernel/linux-3.10.y/drivers/mtd/devices/hifmc100/Kconfig
```kconfig
#
# hisilicon flash memory controller device version 100
#

menuconfig MTD_HIFMC100
	tristate "hisilicon flash memory controller device version 100 driver"
	depends on (ARCH_S40)
	default n if (ARCH_S40)
	select MTD_SPI_IDS
	help
	  Hisilicon flash memory controller device version 100.
	  Hisilicon flash memory controller version 100 support
	  DMA transfers while reading and write the spi flash,
	  which will improve the performace very much.

if MTD_HIFMC100

config HIFMC100_BUFFER_BASE_ADDRESS
	hex "hifmc100 read/write memory base address"
	default "0xFE200000" if (ARCH_S40)

config HIFMC100_REG_BASE_ADDRESS
	hex "hifmc100 register base address"
	default "0xF9950000" if (ARCH_S40)

config HIFMC100_CHIP_NUM
	int "hifmc100 spi chip number"
	default 2 if (ARCH_S40)

config HIFMC100_ENABLE_CHIPSELECT_0
	bool "use spi device on chipselect 0"
	default y if (ARCH_S40)

config HIFMC100_ENABLE_CHIPSELECT_1
	bool "use spi device on chipselect 1"
	default n if (ARCH_S40)

endif # MTD_HIFMC100
```

## bigfish/sdk/source/kernel/linux-3.10.y/drivers/mtd/nand/hifmc100_nand/Kconfig
```kconfig
#
# drivers/mtd/nand/hifmc100/Kconfig
# add by hisilicon 2014.10.9
#

menuconfig MTD_NAND_HIFMC100_NAND
	tristate "Hisilicon Flash Memory Controller v100 nand device Support"
	depends on MTD_NAND
	default n if (ARCH_S40)
	select MISC_FILESYSTEMS
	select MTD_BLOCK
	help
	  Hisilicon Flash Memory Controller version 100 is called hifmc100 for
	  short. The controller support registers and DMA transfers while
	  reading or writing the nand flash.

if MTD_NAND_HIFMC100_NAND

config HIFMC100_NAND_MAX_CHIP
	int "number of spi nand flash chip (1, 2)"
	default 1
	help
	  flash memory controller v100 device only support 1 or 2 nand
	  flash chip, your should not config other value.

config HIFMC100_NAND_CACHE_ENABLE
	bool "enable nand cache feature"
	default y
	help
	  enable cache feature may improve nand startup speed on some file system

config HIFMC100_NAND_DBG_NAND_DEBUG
	bool "Debug: create debug file to control debug type"
	default y
	help
	  Create "debug" file to control debug type.

config HIFMC100_NAND_DBG_NAND_DUMP
	bool "Debug: display read/write/erase process nand data"
	depends on HIFMC100_NAND_DBG_NAND_DEBUG
	default y
	help
	  Create "dump" file dump to display all nand operation and data.

config HIFMC100_NAND_DBG_NAND_ERASE_COUNT
	bool "Debug: display last erase count"
	depends on HIFMC100_NAND_DBG_NAND_DEBUG
	default y
	help
	  Create "erase_count" file to display last erase count.

config HIFMC100_NAND_DBG_NAND_READ_COUNT
	bool "Debug: display last read count"
	depends on HIFMC100_NAND_DBG_NAND_DEBUG
	default y
	help
	  Create "read_count" file to display last read count.

config HIFMC100_NAND_DBG_NAND_ECC_COUNT
	bool "Debug: display last ecc count."
	depends on HIFMC100_NAND_DBG_NAND_DEBUG
	default y
	help
	  Create "ecc_count" to display last ecc count.

config HIFMC100_NAND_DBG_NAND_READ_RETRY
	bool "Debug: display read_retry process"
	depends on HIFMC100_NAND_DBG_NAND_DEBUG
	default y
	help
	  Create read_retry file to display read_retry process.
 
config HIFMC100_NAND_DBG_NAND_CACHE
	bool "Debug: display cache information"
	depends on HIFMC100_NAND_DBG_NAND_DEBUG && HIFMC100_NAND_CACHE_ENABLE
	default y
	help
	  Create data file to display cache information.

choice
	prompt "Pagesize and Ecc Type Select"

config HIFMC100_NAND_AUTO_PAGESIZE_ECC
	bool "Auto"
	help
	  auto-sensed the page size and ecc type value. driver will
	  try each of page size and ecc type one by one till flash
	  can be read and wrote accurately.
	  so the page size and ecc type is match adaptively without
	  switch on the board

config HIFMC100_NAND_PAGESIZE_AUTO_ECC_NONE
	bool "Pagesize Auto, Ecc None"
	help
	  select pagesize 2K, ecc none.

endchoice

endif # MTD_NAND_HIFMC100_NAND
```

## bigfish/sdk/source/kernel/linux-3.10.y/drivers/mtd/nand/hifmc100_snand/Kconfig
```kconfig
#
# drivers/mtd/nand/hifmc100/Kconfig
# add by hisilicon 2014.10.9
#

menuconfig MTD_SPINAND_HIFMC100
	tristate "Hisilicon Flash Memory Controller v100 spi nand device Support"
	depends on MTD_NAND
	default n if (ARCH_S40)
	select MISC_FILESYSTEMS
	select MTD_BLOCK
	help
	  Hisilicon Flash Memory Controller version 100 is called hifmc100 for
	  short. The controller support registers and DMA transfers while
	  reading or writing the spi nand flash.

if MTD_SPINAND_HIFMC100

config HIFMC100_SPINAND_REG_BASE_ADDRESS
	hex "flash memory controller's register base address"
	default 0xF9950000 if (ARCH_S40)
	help
	  register base address of flash memory controller

config HIFMC100_SPINAND_BUFFER_BASE_ADDRESS
	hex "flash memory controller's buffer base address"
	default 0xFE200000 if (ARCH_S40)
	help
	  buffer base address of flash memory controller

config HIFMC100_MAX_CHIP
	int "number of spi nand flash chip (1, 2)"
	default 1
	help
	  flash memory controller v100 device only support 1 or 2 spi nand
	  flash chip, your should not config other value.

choice
	prompt "Pagesize and Ecc Type Select"

config HIFMC100_SPINAND_HARDWARE_PAGESIZE_ECC
	bool "Hardware"
	help
	  the configure of page size and ecc type lie on switch
	  on the board.
	  so the page size and ecc type is controlled by Hardware
	  see demo board of SOC.

config HIFMC100_SPINAND_AUTO_PAGESIZE_ECC
	bool "Auto"
	help
	  auto-sensed the page size and ecc type value. driver will
	  try each of page size and ecc type one by one till flash
	  can be read and wrote accurately.
	  so the page size and ecc type is match adaptively without
	  switch on the board

config HIFMC100_SPINAND_PAGESIZE_AUTO_ECC_NONE
	bool "Pagesize Auto, Ecc None"
	help
	  select pagesize 2K, ecc none.

endchoice

endif # MTD_SPINAND_HIFMC100
```

## bigfish/sdk/source/kernel/linux-3.10.y/drivers/pci/hipcie/Kconfig
```kconfig
menuconfig HIPCIE
	bool "Hisilicon PCI Express support"
	depends on PCI && (ARCH_S40V3 || ARCH_MV410 || ARCH_HIFONE)
	default y if PCI
	default n if ! PCI
	help
	Hisilicon PCI Express support
	Choose this selection to support PCI Express uses.

if HIPCIE

menu "PCI Express configs"

config PCIE0_SEL
        int "PCI Express controller0 sel"
        range 0 1
        default "0" if ! PCI
        default "1" if PCI
        depends on PCI
        help
        PCI Express controller0 sel.
        Set 0 to disable controller 0,
        set 1 to enable controller 0 to work at x1 mode.

config PCIE1_SEL
        int "PCI Express controller1 sel"
        range 0 1
        default "0" if ! PCI
        default "1" if (PCI && ARCH_HIFONE)
        depends on PCI
        help
        PCI Express controller1 sel.
        Set 0 to disable controller 1,
        set 1 to enable controller 1 to work at x1 mode.

config PCIE0_DEVICES_MEM_SIZE
        hex "Total memory size of PCI Express 0 system devices"
        range 0x0 0x7800000 if (ARCH_S40V3 || ARCH_MV410)
		range 0x0 0x2000000 if ARCH_HIFONE
        default "0x7800000" if (ARCH_S40V3 || ARCH_MV410)
		default "0x2000000" if ARCH_HIFONE
        depends on PCI
        help
        All memory size required by all devices in pci subsystem.
        Hisilicon PCI Express controller provide up to 128M memory
        and io size for device.
        Here we set memory size up to 120M, means that io size has at least 8M
        You can change this depend on you device connected
        to Hisilicon PCI Express controller.

config PCIE0_DEVICES_CONFIG_SIZE
        hex "Total configuration header size of PCI Express 0 system devices"
        range 0x0 0x10000000   if (ARCH_S40V3 || ARCH_MV410 || ARCH_HIFONE)
        default 0x800000       if (ARCH_S40V3 || ARCH_MV410 || ARCH_HIFONE)
        depends on PCI
        help
        All configuration size required by devices connnect to
        Hisilicon PCI Express controller.
        NOTE: This will alloc memory from kernel,
        enlarge this will require the same memory.
        The default value is enough for most applications.

config PCIE1_DEVICES_MEM_SIZE
        hex "Total memory size of PCI Express 1 system devices"
        range 0x0 0x2000000 if ARCH_HIFONE
        default "0x2000000" if ARCH_HIFONE
        depends on PCI
        help
        All memory size required by all devices in pci subsystem.
        Hisilicon PCI Express controller provide up to 128M memory
        and io size for device.
        Here we set memory size up to 120M, means that io size has at least 8M
        You can change this depend on you device connected
        to Hisilicon PCI Express controller.

config PCIE1_DEVICES_CONFIG_SIZE
        hex "Total configuration header size of PCI Express 1 system devices"
        range 0x0 0x10000000   if ARCH_HIFONE
        default 0x800000       if ARCH_HIFONE
        depends on PCI
        help
        All configuration size required by devices connnect to
        Hisilicon PCI Express controller.
        NOTE: This will alloc memory from kernel,
        enlarge this will require the same memory.
        The default value is enough for most applications.
        
endmenu

endif
```
