## bigfish/sdk/scripts/kconfig/Kconfig.rootbox
```kconfig
#---------------------------------------------

menu "File System Config"
config  HI_ROOTFS_STRIP
	bool "Enable Strip"
	default y
	help
	  Whether strip the root filesystem.
	  If you select strip option, you will get fail when use gdb, because the clib is striped.
	       y - strip /bin /lib /sbin /usr
	       n - not strip

config  HI_ROOTFS_INSTALL_SHARED_LIBS
	bool "Install Share Libs to Rootbox"
	default y

config  HI_ROOTFS_CRAMFS
	bool "Create Cramfs Rootbox Image"
	default y

config  HI_ROOTFS_JFFS2
	bool "Create Jffs2 Rootbox Image"
	depends on HI_SPI_SUPPORT
	default y

config  HI_ROOTFS_YAFFS
	bool "Create Yaffs Rootbox Image"
	depends on HI_NAND_SUPPORT 
	default y

config  HI_ROOTFS_SQUASHFS
	bool "Create Squashfs Rootbox Image"
	default y

config  HI_ROOTFS_EXT4
	bool "Create ext4 Rootbox Image"
	depends on HI_EMMC_SUPPORT
	default n

config  HI_EMMC_ROOTFS_SIZE
	int "eMMC Rootfs Size"
	depends on HI_ROOTFS_EXT4
	default "96"
	help
	  eMMC rootfs size, unit is M.

config HI_ROOTFS_UBIIMG
	bool "Create Ubi Rootbox Image"
	depends on HI_NAND_SUPPORT
	default y

config HI_UBI_PARTITION_SIZE
	string "UBI Rootfs Size"
	depends on HI_ROOTFS_UBIIMG
	default "96M"

endmenu
#+++++++++++++++++++++++++++++++++++++++++++++++++++
```

## bigfish/sdk/scripts/kconfig/Kconfig.rootfs
```kconfig
#+++++++++++++++++++++++++++++++++++++++++++++++++++
menu "Board Tools Config"
config  HI_TOOL_UDEV_SUPPORT
        bool "Udev Tools Support"
        default y
config  HI_TOOL_DOSFS_SUPPORT
	bool "Dosfs Tools Support"
	default n
config  HI_TOOL_E2FSPROGS_SUPPORT
	bool "Ext2/Ext3 Tools Support"
	default n
config  HI_TOOL_FILECAP_SUPPORT
	bool "Filecap Tools Support"
	default n
	help
	  Filecap is used to change permission of files/dirs.
	  Only for CA user, if don't use CA, say n here.
config  HI_TOOL_GDB_SUPPORT
	bool "GDB/GDBServer Tools Support"
	default n
config  HI_TOOL_IPTABLES_SUPPORT
	bool "Iptables Tools Support"
	default n
config  HI_TOOL_MTDUTILS_SUPPORT
	bool "Mtdutils Tools Support"
	default n
config  HI_TOOL_REG_SUPPORT
	bool "Read/Write Registers Tools Support"
	default y
config  HI_TOOL_REG_UART_SUPPORT
	bool "Read/Write Registers Tools for UART Support"
	default n
	help
	  This tools is used for registers read/write. Not like 
	  HI_TOOL_REG_SUPPORT, this tool only output some specific
	  messages. This is only for PC tool HITOOL.
config  HI_TOOL_SANDBOX_SUPPORT
	bool "Sandbox Tool Support"
	default y
	depends on ADVCA_FUNCTION
	help
	  This tools is used only for CA, if no CA,say n here.
config  HI_TOOL_TOP_SUPPORT
	bool "Standard Top Tools Support"
	default n
config  HI_TOOL_PPPD_SUPPORT
	bool "PPPD Tool Support"
	default n
config  HI_TOOL_MIITOOLS_SUPPORT
	bool "Mii Tool Support"
	default n
config  HI_TOOL_IPERF_SUPPORT
	bool "Iperf Support"
	default n
config  HI_TOOL_MSP_DEBUG_SUPPORT
	bool "Msp Debug Tool Support"
	default n
config  HI_TOOL_PQ_DEBUG_SUPPORT
	bool "PQ Debug Tool Support"
	default y	
config  HI_TOOL_SOC_SERVER
	bool "SOC Server Tool Support"
	default n
config  HI_LXC_CONTAINER_SUPPORT
	bool "LXC Container Tools Support"
	default n
config  HI_TOOL_SYSSTAT_SUPPORT
	bool "Sysstat Tool Support"
	default n
config  HI_TOOL_MEMTESTER_SUPPORT
	bool "Memtester Tool Support"
	default n
endmenu

menu "Busybox Config"

config  HI_BUSYBOX_CFG_NAME
	string "Busybox Config File For Root" 
	default glibc.config
	help
	  Input config file for root busybox. Such as xxxxx.config.
	  Config files are located in busybox source: busybox-1.16.1.config/

config  HI_BUSYBOX_CFG_USER_NAME
	string "Busybox Config File For User" 
	default glibc.config
	depends on ADVCA_FUNCTION && HI_LOADER_APPLOADER!=y
	help
	  Input config file for user busybox. Such as xxxxx.config.
	  Config files are located in busybox source: busybox-1.16.1.config/

endmenu

config  HI_LIBCPP_SUPPORT
	bool "C++ Runtime Libarary Support"
	default y
	help
	  If you need use C++ libarary, say y here.

#---------------------------------------------
#+++++++++++++++++++++++++++++++++++++++++++++++++++
```

## bigfish/sdk/scripts/kconfig/Kconfig.tvp
```kconfig
config HI_TVP_SUPPORT
    bool "Trusted Video Path Support"
    depends on (HI3798MV100 || HI3796MV100 || HI3798CV200_A)
    default n
    help
        Support trusted video path function enables you to use secure os and memory.
        You should say n here, unless you really know what are you doing.
        Say yes here can get trusted video path.

choice
    prompt "TVP Memory Layout"
    depends on HI_TVP_SUPPORT
    default 1G

config  TVP_MEM_1G
    bool "1G"
config  TVP_MEM_2G
    bool "2G"
endchoice

config  HI_TVP_MEM_LAYOUT
    string
    default 1G     if TVP_MEM_1G
    default 2G     if TVP_MEM_2G
```

## bigfish/sdk/scripts/kconfig/Kconfig.uboot
```kconfig
#+++++++++++++++++++++++++++++++++++++++++++++++++++
menuconfig HI_FORCE_ENV_TO_MEDIA
	bool "Force Envionment variables to Nand/SPI Flash/eMMC"
	default n
	help
	  This option enables forcing envionment variables to Nand/SPI Flash/eMMC.
	  if not enabled, the envionment variables are saved to the boot media, that is to say,
	  if the boot is burnt to SPI Flash, the envionment variables are saved to SPI Flash.
	  The media for choosing:
		Nand
		SPI Flash
		eMMC 


source "scripts/kconfig/Kconfig.env.media"

config HI_BOOT_ENV_STARTADDR
	hex "Envioronment Variables Partition Start Address"
	default 0x80000
	help
	  The start address of the partition you want to save your envioronment variables.

config HI_BOOT_ENV_SIZE
	hex "Envioronment Variables Partition Size"
	default 0x2000
	help
	  The size of the partition you want to save your envioronment variables.
config HI_BOOT_ENV_RANGE
	hex "Envioronment Variables Partition Read/Write Range"
	default HI_BOOT_ENV_SIZE
	help
	  When read/write environment variables,if there are bad blocks,
	  this indicates the size driver should skip.Default value set to 
	  be the size of envioronment variables partition size, usually one
	  block.Only useful for nand.

config HI_BOOT_ENV_BAK_SUPPORT
	bool "Bakup Envioronment support"
	default y
	help
	  The bakup Envioronment support. When read and check Envioronment failed,
	  we should try bakup Envioronment.

config HI_BOOT_ENV_STARTADDR_BAKUP
	hex "Bakup envioronment Variables Partition Start Address"
	depends on HI_BOOT_ENV_BAK_SUPPORT
	default HI_BOOT_ENV_STARTADDR
	help
	  The start address of the partition you want to save your BAKUP envioronment variables.

config HI_BOOT_COMPRESSED
        bool "Build Compressed Fastboot Image"
        default n
        help
          Say y here if you want to build compressed fastboot image. The compressed
          fastboot image is smaller.

config HI_BENCH_SUPPORT
	bool "Support HiBench"
	default n
	help
	  HiBench is a tool which can test your cpu. You can run HiBench with "run" command in boot command line.
	  Say y here if you want to run HiBench.

config HI_BOOT_USB_SUPPORT
	bool "Support Usb Drivers"
	default n
	help
	  Say y here if you want to support usb for boot.

menu "Build Product Code in Fastboot"
config HI_BUILD_WITH_PRODUCT
	bool "Build Product Code in Fastboot"
	default n
	help
	  This option enables you to build product directory in fastboot. Final
	  fastboot-burn.bin contains product. If you set to n here, product
	  will not build with fastboot, there will generate another bin file,
	  which can be run up by "bootapp (addr)" cmd.

source "scripts/kconfig/Kconfig.bootloader"

menuconfig HI_BUILD_WITH_FRONTEND
	bool "Build Frontend Code in Fastboot"
	depends on HI_BUILD_WITH_PRODUCT
	default y

config HI_BOOT_DISEQC_SUPPORT
	depends on HI_BUILD_WITH_FRONTEND
	bool "DISEQC Support"
	default n

menu "Tuner Used in Fastboot"
	depends on HI_BUILD_WITH_FRONTEND

config  HI_BOOT_TUNER_TYPE_ALPS_TDAE
	depends on HI_BUILD_WITH_FRONTEND
	bool "ALPS_TDAE Support"
	default y

config  HI_BOOT_TUNER_TYPE_TDCC
	depends on HI_BUILD_WITH_FRONTEND
	bool "TDCC Support"
	default y

config  HI_BOOT_TUNER_TYPE_TDA18250
	depends on HI_BUILD_WITH_FRONTEND
	bool "TDA18250 Support"
	default y
	
config  HI_BOOT_TUNER_TYPE_TDA18250B
	depends on HI_BUILD_WITH_FRONTEND
	bool "TDA18250B Support"
	default y
	
config  HI_BOOT_TUNER_TYPE_SI2147
	depends on HI_BUILD_WITH_FRONTEND
	bool "SI2147 Support"
	default y
	
config  HI_BOOT_TUNER_TYPE_TMX7070X
	depends on HI_BUILD_WITH_FRONTEND
	bool "TMX7070X Support"
	default y
	
config  HI_BOOT_TUNER_TYPE_R820C
	depends on HI_BUILD_WITH_FRONTEND
	bool "R820C Support"
	default y
			
config  HI_BOOT_TUNER_TYPE_MXL203
	depends on HI_BUILD_WITH_FRONTEND
	bool "MXL203 Support"
	default y

config  HI_BOOT_TUNER_TYPE_AV2011
	depends on HI_BUILD_WITH_FRONTEND
	bool "AV2011 Support"
	default y

config  HI_BOOT_TUNER_TYPE_SHARP7903
	depends on HI_BUILD_WITH_FRONTEND
	bool "SHARP7903 Support"
	default y

config  HI_BOOT_TUNER_TYPE_MXL603
	depends on HI_BUILD_WITH_FRONTEND
	bool "MXL603 Support"
	default y

endmenu

menu "Demod Used in Fastboot"
	depends on HI_BUILD_WITH_FRONTEND

config  HI_BOOT_DEMOD_TYPE_HI3130I
	depends on HI_BUILD_WITH_FRONTEND
	bool "HI3130_INSIDE Support"
	default y
	
config  HI_BOOT_DEMOD_TYPE_HI3136
	depends on HI_BUILD_WITH_FRONTEND
	bool "HI3136 Support"
	default y

endmenu

menu "LNB Chip Used in Fastboot"
	depends on HI_BUILD_WITH_FRONTEND
config  HI_BOOT_LNB_CTRL_ISL9492
	depends on HI_BUILD_WITH_FRONTEND
        bool "ISL9492 Support"
        default y

config  HI_BOOT_LNB_CTRL_MPS8125
	depends on HI_BUILD_WITH_FRONTEND
        bool "MPS8125 Support"
        default y
endmenu

config  HI_BUILD_WITH_DEMUX
        bool "Build DEMUX in Fastboot"
        depends on HI_BUILD_WITH_PRODUCT

#config  HI_BUILD_WITH_IR
#        bool "Build IR in Fastboot"
#        depends on HI_BUILD_WITH_PRODUCT

config  HI_BUILD_WITH_ANDROID
        bool "Build ANDROID Partion in Fastboot"
        depends on HI_BUILD_WITH_PRODUCT
        default n

config HI_BUILD_WITH_KEYLED
        bool "Build Keyled in Fastboot"
        depends on HI_BUILD_WITH_PRODUCT && (HI_KEYLED_74HC164_SUPPORT || HI_KEYLED_CT1642_SUPPORT || HI_KEYLED_PT6961_SUPPORT || HI_KEYLED_PT6964_SUPPORT || HI_KEYLED_FD650_SUPPORT)
        default y

config HI_BUILD_WITH_IR
	bool "Build IR in Fastboot"
	depends on HI_BUILD_WITH_PRODUCT
	default n
	
config HI_BUILD_WITH_HDMI_EDID
	bool "Build EDID in Fastboot"
	depends on HI_BUILD_WITH_PRODUCT
	default n
	
config HI_BUILD_WITH_HDMI_CEC
	bool "Build CEC in Fastboot"
	depends on HI_BUILD_WITH_PRODUCT
	default n

endmenu
```

## bigfish/sdk/scripts/kconfig/Kconfig.vdec
```kconfig
#+++++++++++++++++++++++++++++++++++++++++++++++++++
menu "Video Decoder Config"
#+++++++++++++++++++++++++++++++++++++++++++++++++++

source "scripts/kconfig/Kconfig.vdec.mem512"
source "scripts/kconfig/Kconfig.vdec.mem768"
source "scripts/kconfig/Kconfig.vdec.mem1024"
source "scripts/kconfig/Kconfig.vdec.mem2048"

config  HI_VDEC_DEINTERLACE_SUPPORT
	bool "HD Deinterlace Support"
	default y
	help
		Open deinterlace function, if you have enough memory, say y.

config  HI_VDEC_SVDEC_SUPPORT
	bool "Soft Video Decode(hi_svdec.ko) Support"
	default y
	help
		For Hi3712, if you want to support H263, say y;
		For Hi3716C/Hi3716H/Hi3716M, if you want to support H263 or VP6, say y;

config  HI_VDEC_REG_CODEC_SUPPORT
	bool "External Video Codec Register Support"
	default n
	help
		If you want to use API "HI_UNF_AVPLAY_RegisterVcodecLib()", say y.

config  HI_VDEC_MJPEG_SUPPORT
	bool "Motion JPEG Decoder Support"
	default n
	help
		If you want to use decode Motion JPEG stream, say y.

config  HI_VDEC_VPU_SUPPORT
	bool "VPU Decode Support"
	depends on (HI3798CV100 || HI3796CV100)
	default n
	help
		If you want to use VPU Decoder, say y.

config  HI_VDEC_USERDATA_CC_SUPPORT
	bool "Closed Caption User Data Support"
	default y
	help
		If you want to receive closed caption user data, say y.

config  HI_VDEC_USERDATA_CC_BUFSIZE
	hex "Closed Caption User Data Buffer Size(0x4000~0x40000)"
	depends on HI_VDEC_USERDATA_CC_SUPPORT
	range 0x4000 0x40000
	default 0xC000
	help
		Closed caption user data buffer size. Recommend 0xC000.
	
config HI_VDEC_DFS_SUPPORT
	bool "Dynamic Frame Store Support"
	default n
	help
		if you want to use this feature, say y.

config HI_VDEC_PRE_ALLOC_VDHMMZ_SUPPORT
	bool "pre alloc video decoder frame buffer support"
	default n
	help
		if you want to use this feature, say y.
endmenu
#+++++++++++++++++++++++++++++++++++++++++++++++++++
```

## bigfish/sdk/scripts/kconfig/Kconfig.venc
```kconfig
#+++++++++++++++++++++++++++++++++++++++++++++++++++
#menu "VENC Config"
#--------------------------------

config  HI_VENC_SUPPORT
	help
	    this option should be chosen on transcode scene
	depends on !HI3712
	bool "VENC Support" 
	default n

#endmenu
#+++++++++++++++++++++++++++++++++++++++++++++++++++
```

## bigfish/sdk/scripts/kconfig/Kconfig.vi
```kconfig
config  HI_VI_SUPPORT
    bool "VI Support"
    default n

config  HI_VI_BT656_HIGH8
    bool "VI BT656 selection High 8bit"
    depends on HI_VI_SUPPORT
    default n

config  HI_HDMI_RX_SUPPORT
    bool "HDMI RX Support"
    depends on HI_VI_SUPPORT && (HI3796CV100 || HI3798CV100 || HI3798CV200_A)
    default y
```

## bigfish/sdk/scripts/kconfig/Kconfig.voip
```kconfig
#+++++++++++++++++++++++++++++++++++++++++++++++++++

config HI_VOIP_SUPPORT
	depends on (HI3716CV200 || HI3716MV400 || HI3718CV100 || HI3719CV100 || HI3718MV100 || HI3719MV100)
	bool "VOIP Support"
	default n

#+++++++++++++++++++++++++++++++++++++++++++++++++++
```

## bigfish/sdk/scripts/kconfig/Kconfig.wifi
```kconfig
#+++++++++++++++++++++++++++++++++++++++++++++++++++
#--------------------------------
menuconfig HI_WIFI_SUPPORT
	bool "WiFi Support"
	default n
	depends on LINUX_PRODUCT
	help
	  This section contains all the supported 802.11 wireless device drivers.
	  Set to 'y' to support this device, 'n' not support.

menu    "WiFi Device Type"
	depends on HI_WIFI_SUPPORT

config  HI_WIFI_DEVICE_RTL8188CUS
	bool "Realtek RTL8188CUS (11n 1x1 2.4G USB)"
	depends on ANDROID_PRODUCT
config  HI_WIFI_DEVICE_RTL8192CU
	bool "Realtek RTL8192CU (11n 2x2 2.4G USB)"
	depends on ANDROID_PRODUCT
config  HI_WIFI_DEVICE_RTL8188EUS
	bool "Realtek RTL8188ETV and RTL8188EUS (11n 1x1 2.4G USB)"
config  HI_WIFI_DEVICE_RTL8192EU
	bool "Realtek RTL8192EU (11n 2x2 2.4G USB)"
	depends on ANDROID_PRODUCT
config  HI_WIFI_DEVICE_RTL8192DU
	bool "Realtek RTL8192DU (11n 2x2 2.4G+5G USB)"
	depends on ANDROID_PRODUCT
config  HI_WIFI_DEVICE_RT5370
	bool "Mediatek RT3070 and RT5370 (11n 1x1 2.4G USB)"
	depends on ANDROID_PRODUCT
config  HI_WIFI_DEVICE_MT7601U
	bool "Mediatek MT7601U (11n 1x1 2.4G USB)"
	depends on ANDROID_PRODUCT
config  HI_WIFI_DEVICE_RT5572
	bool "Mediatek RT5572 (11n 2x2 2.4G+5G USB)"
	depends on ANDROID_PRODUCT
config  HI_WIFI_DEVICE_AR9271
	bool "Atheros AR9271 (11n 1x1 2.4G USB)"
	depends on ANDROID_PRODUCT
config  HI_WIFI_DEVICE_AR9374
	bool "Atheros AR9374 (11n 2x2 2.4G+5G USB)"
	depends on ANDROID_PRODUCT
config  HI_WIFI_DEVICE_QCA1021G
	bool "Atheros QCA1021G (11n 2x2 2.4G USB)"
	depends on ANDROID_PRODUCT
config  HI_WIFI_DEVICE_QCA1021X
	bool "Atheros QCA1021X (11n 2x2 2.4G+5G USB)"
	depends on ANDROID_PRODUCT
config  HI_WIFI_DEVICE_BCM43236
	bool "Broadcom BCM43236 (11n 2x2 2.4G+5G USB)"
	depends on ANDROID_PRODUCT
config  HI_WIFI_DEVICE_MT76X2U
	bool "MediaTek MT76x2TU and MT76x2U"

endmenu

menu	"WiFi Working Mode"
	depends on HI_WIFI_SUPPORT

config  HI_WIFI_MODE_STA
	bool "STA Mode"
config  HI_WIFI_MODE_AP
	bool "SoftAP Mode"
endmenu
```

## bigfish/sdk/scripts/kconfig/Kconfig.zlib
```kconfig
#+++++++++++++++++++++++++++++++++++++++++++++++++++
# menu "Zlib Config"
#+++++++++++++++++++++++++++++++++++++++++++++++++++

config HI_ZLIB_SUPPORT
	bool "Zlib Support"
	default y

#+++++++++++++++++++++++++++++++++++++++++++++++++++
# endmenu
#+++++++++++++++++++++++++++++++++++++++++++++++++++
```
